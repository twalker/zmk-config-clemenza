## config/boards/shields/clemenza/Kconfig.defconfig
```kconfig
if SHIELD_CLEMENZA_LEFT

# Name must be less than 16 characters long!
config ZMK_KEYBOARD_NAME
    default "clemenza"

config ZMK_SPLIT_ROLE_CENTRAL
    default y

endif

if SHIELD_CLEMENZA_LEFT || SHIELD_CLEMENZA_RIGHT

config ZMK_SPLIT
    default y

endif

if SHIELD_CLEMENZA_RIGHT

config SPI
    default y

endif
```

## config/boards/shields/clemenza/Kconfig.shield
```kconfig
# No whitespace after the comma or in your part name!
config SHIELD_CLEMENZA_LEFT
    def_bool $(shields_list_contains,clemenza_left)

# No whitespace after the comma or in your part name!
config SHIELD_CLEMENZA_RIGHT
    def_bool $(shields_list_contains,clemenza_right)
```
